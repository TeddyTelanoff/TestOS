OUTPUT_FORMAT("binary")
ENTRY(Boot)
SECTIONS
{
    .text ALIGN(4K) : AT(0x7C00)
    {
        *(.text)
    }

    .rodata BLOCK(4K) : ALIGN(4K)
    {
        *(.rodata)
    }

    .data BLOCK(4K) : ALIGN(4K)
    {
        *(.data)
    }

    .bss BLOCK(4K) : ALIGN(4K)
    {
        *(.bss)
    }
}